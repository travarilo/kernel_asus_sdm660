## drivers/net/wireless/realtek/Kconfig
```kconfig
 source "drivers/net/wireless/realtek/rtl818x/Kconfig"
 source "drivers/net/wireless/realtek/rtlwifi/Kconfig"
 source "drivers/net/wireless/realtek/rtl8xxxu/Kconfig"
 source "drivers/net/wireless/realtek/rtl8812au/Kconfig"
```

## fs/exfat/Kconfig
```kconfig
config EXFAT_FS
	tristate "exFAT fs support"
	default m
	select NLS
	select NLS_UTF8
	select NLS_CODEPAGE_437
	select NLS_ISO8859_1
	help
	  If you want to use the exFAT file systems, then you must say Y or M here
	  to inlucde exFAT support.

config EXFAT_USE_FOR_VFAT
	bool "Register exFAT as VFAT"
	default y
	depends on EXFAT_FS && !VFAT_FS
	help
	  If you want to register exFAT as available for VFAT, say Y.

config EXFAT_DISCARD
	bool "Enable discard support"
	depends on EXFAT_FS
	default y

config EXFAT_KERNEL_DEBUG
	bool "Enable kernel debug features via ioctl"
	depends on EXFAT_FS
	default n

config EXFAT_DEBUG_MSG
	bool "Print debug messages"
	depends on EXFAT_FS
	default n

config EXFAT_DEFAULT_CODEPAGE
	int "Default codepage for exFAT"
	default 437
	depends on EXFAT_FS
	help
	  This option should be set to the codepage of your exFAT filesystems.

config EXFAT_DEFAULT_IOCHARSET
	string "Default iocharset for exFAT"
	default "utf8"
	depends on EXFAT_FS
	help
	  Set this to the default input/output character set you'd like exFAT to use.

config EXFAT_VIRTUAL_XATTR
	bool "Virtual xattr support for exFAT filesystem"
	default y
	depends on EXFAT_FS
	help
	  Modification of exFAT filesystem for virtual xattr

config EXFAT_VIRTUAL_XATTR_SELINUX_LABEL
	string "Default string for SELinux label"
	depends on EXFAT_FS && EXFAT_VIRTUAL_XATTR
	default "u:object_r:sdcard_external:s0"
	help
	  Set this to the default string for SELinux label.

config EXFAT_SUPPORT_STLOG
	bool "Enable storage log"
	default y
	depends on EXFAT_FS && PROC_STLOG
```
